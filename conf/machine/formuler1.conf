## conf/machine/formuler1.conf
```bitbake
#@TYPE: Machine
#@NAME: formuler f1
#@DESCRIPTION: Machine configuration for the formuler f1

MKUBIFS_ARGS = "-m 2048 -e 126976 -c 8192"
UBINIZE_ARGS = "-m 2048 -p 128KiB"

MACHINE_FEATURES += "textlcd dvb-c"

IMAGE_FSTYPES ?= "ubi tar.gz"

CHIPSET = "bcm7356"
RCTYPE = "18"

require conf/machine/include/formuler.inc
```

## conf/machine/formuler3.conf
```bitbake
#@TYPE: Machine
#@NAME: formuler f3
#@DESCRIPTION: Machine configuration for the formuler f3

MKUBIFS_ARGS = "-m 2048 -e 126976 -c 8192"
UBINIZE_ARGS = "-m 2048 -p 128KiB"

MACHINE_FEATURES += "textlcd"

CHIPSET = "bcm7362"
RCTYPE = "18"

require conf/machine/include/formuler.inc
```

## conf/machine/formuler4.conf
```bitbake
#@TYPE: Machine
#@NAME: formuler f4
#@DESCRIPTION: Machine configuration for the formuler f4

MKUBIFS_ARGS = "-m 2048 -e 126976 -c 8192"
UBINIZE_ARGS = "-m 2048 -p 128KiB"

MACHINE_FEATURES += "textlcd"

CHIPSET = "bcm7362"
RCTYPE = "18"

require conf/machine/include/formuler.inc
```

## conf/machine/formuler4turbo.conf
```bitbake
#@TYPE: Machine
#@NAME: formuler f4turbo
#@DESCRIPTION: Machine configuration for the formuler f4turbo

MKUBIFS_ARGS = "-m 2048 -e 126976 -c 8192"
UBINIZE_ARGS = "-m 2048 -p 128KiB"

MACHINE_FEATURES += "textlcd ci"

DVBMEDIASINK_CONFIG_append = " --with-h265 --with-vb6 --with-vb8 --with-spark"

CHIPSET = "bcm73625"
RCTYPE = "18"

require conf/machine/include/formuler-next.inc
```
